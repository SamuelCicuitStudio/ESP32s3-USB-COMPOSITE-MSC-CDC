## USB_MSC/sdkconfig.defaults
```kconfig
CONFIG_IDF_TARGET="esp32s3"
CONFIG_ESP_SYSTEM_SINGLE_CORE_MODE=n
CONFIG_FREERTOS_UNICORE=n
CONFIG_FREERTOS_HZ=1000

# Keep logs on UART0. Native USB is owned by TinyUSB MSC.
CONFIG_ESP_CONSOLE_UART_DEFAULT=y
CONFIG_ESP_CONSOLE_SECONDARY_NONE=y
# CONFIG_ESP_CONSOLE_SECONDARY_USB_SERIAL_JTAG is not set

# Use the local partition table in this example folder.
CONFIG_PARTITION_TABLE_CUSTOM=y
CONFIG_PARTITION_TABLE_CUSTOM_FILENAME="partitions.csv"
CONFIG_PARTITION_TABLE_FILENAME="partitions.csv"
CONFIG_PARTITION_TABLE_OFFSET=0x8000
```

## sdkconfig.defaults
```kconfig
CONFIG_IDF_TARGET="esp32s3"
CONFIG_ESP_SYSTEM_SINGLE_CORE_MODE=n
CONFIG_FREERTOS_UNICORE=n
CONFIG_FREERTOS_HZ=1000
# USB
CONFIG_USB_OTG_SUPPORTED=y
CONFIG_TINYUSB_CDC_ENABLED=y
CONFIG_TINYUSB_MSC_ENABLED=y
CONFIG_TINYUSB_CDC_RX_BUFSIZE=256
CONFIG_TINYUSB_CDC_TX_BUFSIZE=256
CONFIG_TINYUSB_MSC_BUFSIZE=512
```
